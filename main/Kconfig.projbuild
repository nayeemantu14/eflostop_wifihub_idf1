## main/Kconfig.projbuild
```kconfig
config APP_BENCH_DIAG
    bool
    default y
    help
        Bench diagnostics for the 2.1.4 G0 baseline (plan section 2.4). wifi_manager_start() turns
        the Wi-Fi driver's "wifi" log tag off. With this option, app_wifi_start() sets it back to
        INFO right after, so the bench log carries the driver's own lines: channel switches and
        CSA (csa_count), station join and leave, and the STA's connect states. It also prints one
        warning at boot, "bench build (APP_BENCH_DIAG): ...", so a log shows the kind of image.

        No prompt, on purpose: the default below is the value of every build. sdkconfig is
        untracked, and kconfgen loads it over the defaults, so a prompted option would keep the
        y an earlier build stored there, and a change of the default would not reach that
        machine. To turn it off, set the default to n here: WP10 does so for the release.

        Default y during 2.1.4 development only. Not for a release image or the production
        tool: the driver prints many lines, and its connect line carries the router's SSID next
        to its BSSID ("connected with <SSID>, ..., bssid = <MAC>"). With an SSID that contains
        "mac", the production tool's boot-log parse (a line with "wifi", "mac" and a colon-MAC)
        would take the router's BSSID for the hub's Wi-Fi MAC.

config APP_RADIO_LAB
    bool "Radio lab image for the G1 bench (not for release)"
    default n
    help
        The 2.1.4 G1 lab ladder (plan sections 4.3, 4.9 C11, 11 WP7, 12 G1; main/radio_policy/
        radio_lab.c). The console keys that lora_task polls then switch, at run time and kept in
        NVS across reboots, the radio policy's open choices: the SERVE rung (AP_IDLE density,
        SERVE-A-thin, SERVE-A, SERVE-C, SERVE-B), AP_IDLE's Wi-Fi slot (0.3 or 0.6 s), the join
        assist, contingency K1, and C11's two Wi-Fi knobs. The defaults are the production values.
        SERVE-C breaks invariant I8 and the period rule: lab data only.

        Without it (the default) nothing of the lab is compiled in, and every object is the same
        byte for byte. Unlike APP_BENCH_DIAG it has a prompt, so that a separate sdkconfig can set
        it: the G1 procedure builds the lab image in a build folder of its own, with a copy of the
        project's sdkconfig. Never set it in the project's sdkconfig: kconfgen would keep the y for
        every later build. A lab image also needs APP_BENCH_DIAG (radio_lab.c stops the build
        otherwise), so it cannot reach a release once WP10 turns that off.
```
